	#include "processor_def.inc"
	#include "constants.inc"
	#include "memory.inc"

	GLOBAL	init_spi
	GLOBAL	bb_spi_send

spi	CODE

	CONSTANT	_block_start = $
check_start_spi:	
	
	;; this code does not need to live in any particular page.

;;; bit-banging clock polarity is 1 (high is passive)
init_spi:
	bsf	BB_SPI_CLK

;;;  set up built-in SPI interface
	banksel SSPSTAT
	bcf     SSPSTAT, SMP ; SPI input sample phase = 0 (sample @ middle)
	bcf     SSPSTAT, CKE ; SPI clock edge select = 0 (data xmit @ falling edge - which is the leading edge, actually, since clock polarity is 1)
	banksel SSPCON
	bsf     SSPCON, CKP ; clock polarity = 1 (high value is passive)
	bcf     SSPCON, SSPM3 ; start off with the SPI bus in slow mode,
	bcf     SSPCON, SSPM2 ; until we've initialized the SD card.
	bsf     SSPCON, SSPM1 ; 3:0 = 0010 (master, clock=osc/64)
	bcf     SSPCON, SSPM0
	bsf     SSPCON, SSPEN ; turn on SSP. Right now!

	banksel	PORTA
	
	return
	
;;; This is a .0000025 second delay loop, for bit-banging routines to keep a
;;; 400kHz clock speed. It's timed for an 8MHz clock. It was generated by
;;; http://www.piclist.com/cgi-bin/delay.exe
;;; bb_spi_delay:
;;; 	nop			; 1 cycle
;;; 	return			; 4 cycles (including call) = exactly 2.5*10^-6
	
;;; bb_spi is a bit-banging version of the SPI routine - SEND ONLY.
bb_spi_send:
	;; for each bit, put the bit on the serial register and tock the
	;; clock. Max tock frequency is 400kHz, so be sure that the delays
	;; adequately represent that timing. They can be longer without
	;; impact. At least, so far as I've seen...
	movwf	bb_spi_tmp

	movlw	0x08
	movwf	bb_spi_loopcnt
bb_spi_loop:	
	bcf	BB_SPI_DO
	rlf	bb_spi_tmp, F
	btfsc	STATUS, C
	bsf	BB_SPI_DO
	bcf	BB_SPI_CLK 	; tock the clock
	;; wait .0000025 seconds (to enforce 400Hz minimum timing)
;;; delay apparently not necessary @ 8MHz when talking to a D/A chip.
;;; 	call	bb_spi_delay
	bsf	BB_SPI_CLK

	decfsz	bb_spi_loopcnt, F
	goto	bb_spi_loop

	return

check_end_spi:	
	if ( ((_block_start & 0x1800) >> 11) != (($ & 0x1800) >> 11) )
	ERROR	"spi.asm crosses a page boundary"
	endif
	
	END
	
